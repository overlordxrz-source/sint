## firmware/sdkconfig.defaults
```kconfig
CONFIG_ESP32S3_DEFAULT_CPU_FREQ_240=y
CONFIG_WIFI_STATIC_RX_BUFFER_NUM=16
CONFIG_WIFI_DYNAMIC_RX_BUFFER_NUM=64
CONFIG_ESP32_WIFI_CSI_ENABLED=y
CONFIG_LWIP_SO_RCVBUF=y
```
